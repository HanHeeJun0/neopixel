# file: neopixel.ioc
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Dma.Request0=TIM3_CH3
Dma.TIM3_CH3.0.Direction=DMA_MEMORY_TO_PERIPH
Dma.TIM3_CH3.0.EventEnable=DISABLE
Dma.TIM3_CH3.0.Instance=DMA1_Channel1
Dma.TIM3_CH3.0.MemDataAlignment=DMA_MDATAALIGN_BYTE
Dma.TIM3_CH3.0.MemInc=DMA_MINC_ENABLE
Dma.TIM3_CH3.0.Mode=DMA_CIRCULAR
Dma.TIM3_CH3.0.PeriphDataAlignment=DMA_PDATAALIGN_HALFWORD
Dma.TIM3_CH3.0.PeriphInc=DMA_PINC_DISABLE
Dma.TIM3_CH3.0.Polarity=HAL_DMAMUX_REQ_GEN_RISING
Dma.TIM3_CH3.0.Priority=DMA_PRIORITY_LOW
Dma.TIM3_CH3.0.RequestNumber=1
Dma.TIM3_CH3.0.SignalID=NONE
Dma.TIM3_CH3.0.SyncEnable=DISABLE
Dma.TIM3_CH3.0.SyncPolarity=HAL_DMAMUX_SYNC_NO_EVENT
Dma.TIM3_CH3.0.SyncRequestNumber=1
Dma.TIM3_CH3.0.SyncSignalID=NONE
Mcu.Family=STM32G0
Mcu.Name=STM32G0B1R(B-C-E)Tx
Mcu.Package=LQFP64
NVIC.DMA1_Channel1_IRQn=true\:0\:0\:false\:false\:true\:false\:true\:true
PC8.Signal=S_TIM3_CH3
PF0-OSC_IN\ (PF0).Mode=HSE-External-Oscillator
PF0-OSC_IN\ (PF0).Signal=RCC_OSC_IN
PF1-OSC_OUT\ (PF1).Mode=HSE-External-Oscillator
PF1-OSC_OUT\ (PF1).Signal=RCC_OSC_OUT
ProjectManager.HeapSize=0x200
ProjectManager.StackSize=0x400
ProjectManager.TargetToolchain=STM32CubeIDE
RCC.ADCFreq_Value=64000000
RCC.AHBFreq_Value=64000000
RCC.CortexFreq_Value=64000000
RCC.EXTERNAL_CLOCK_VALUE=48000
RCC.HCLKFreq_Value=64000000
RCC.HSE_VALUE=8000000
RCC.HSI48_VALUE=48000000
RCC.HSISYSCLKDivider=RCC_HSI_DIV128
RCC.HSI_VALUE=16000000
RCC.LSE_VALUE=32768
RCC.SYSCLKFreq_VALUE=64000000
RCC.SYSCLKSource=RCC_SYSCLKSOURCE_PLLCLK
RCC.USBFreq_Value=48000000
RCC.VCOOutputFreq_Value=128000000
SH.S_TIM3_CH3.0=TIM3_CH3,PWM Generation3 CH3
TIM3.Channel-PWM\ Generation3\ CH3=TIM_CHANNEL_3
TIM3.Period=80-1
VP_SYS_VS_DBSignals.Mode=DisableDeadBatterySignals
VP_TIM3_VS_ClockSourceINT.Mode=Internal
board=custom

// file: Core/Src/main.c
/* USER CODE BEGIN Header */
/**
  ******************************************************************************
  * @file           : main.c
  * @brief          : Main program body
  ******************************************************************************
  * @attention
  *
  * Copyright (c) 2024 STMicroelectronics.
  * All rights reserved.
  *
  * This software is licensed under terms that can be found in the LICENSE file
  * in the root directory of this software component.
  * If no LICENSE file comes with this software, it is provided AS-IS.
  *
  ******************************************************************************
  */
/* USER CODE END Header */
#include "main.h"
#include "dma.h"
#include "tim.h"
#include "gpio.h"

/* USER CODE BEGIN Includes */

#include <string.h>
#include <stdbool.h>

/* USER CODE END Includes */

/* USER CODE BEGIN PV */

#define LED   21
#define LED_BRIGHTNESS 125 // 0~255
#define HIGH  40
#define LOW   19

bool is_init = false;

typedef struct
{
  uint16_t LED_CNT;
} ws2812_t;

static uint8_t led_buf[280 + 24*LED];

ws2812_t ws2812;
extern TIM_HandleTypeDef htim3;

/* USER CODE END PV */

void SystemClock_Config(void);

/* USER CODE BEGIN 0 */

bool ws2812Init(void)
{
  memset(led_buf, 0, sizeof(led_buf));

  is_init = true;

  return true;
}

void ws2812Begin(uint32_t led_cnt)
{
  ws2812.LED_CNT = led_cnt;

  HAL_TIM_PWM_Start_DMA(&htim3, TIM_CHANNEL_3, (uint32_t *)led_buf, (280 + 24 * led_cnt) * 1);
}

void ws2812SetColor(uint32_t index, uint8_t red, uint8_t green, uint8_t blue)
{
  uint8_t r_bit[8];
  uint8_t g_bit[8];
  uint8_t b_bit[8];

  uint32_t offset;

  for (int i=0; i<8; i++)
  {
    if (red & (1<<7))
    {
      r_bit[i] = HIGH;
    }
    else
    {
      r_bit[i] = LOW;
    }
    red <<= 1;

    if (green & (1<<7))
    {
      g_bit[i] = HIGH;
    }
    else
    {
      g_bit[i] = LOW;
    }
    green <<= 1;

    if (blue & (1<<7))
    {
      b_bit[i] = HIGH;
    }
    else
    {
      b_bit[i] = LOW;
    }
    blue <<= 1;
  }

  offset = 280;

    memcpy(&led_buf[offset + index*24 + 8*0], g_bit, 8*1);
    memcpy(&led_buf[offset + index*24 + 8*1], r_bit, 8*1);
    memcpy(&led_buf[offset + index*24 + 8*2], b_bit, 8*1);
}

void offLed() {
	for(int i=0; i<21; i++)
	{
		ws2812SetColor(i, 0, 0, 0);
	}
}

void rgbLed() {
	for(int i=0; i<3; i++)
	{
		for(int j=0; j<21; j++)
		{
			if(i==0) {
			  ws2812SetColor(j, 255, 0, 0);
			} else if(i==1) {
			  ws2812SetColor(j, 0, 255, 0);
			} else if(i==2) {
			  ws2812SetColor(j, 0, 0, 255);
			}
			HAL_Delay(20);
		}
	}
	offLed();
}

void sirenLed() {
	for(int n=0; n<10; n++)
	{
		for(int i=0; i<8; i++)
		{
			ws2812SetColor(i, 255, 0, 0);
		}
		for(int i=8; i<21; i++)
		{
			ws2812SetColor(i, 0, 0, 255);
		}
		HAL_Delay(100);
		for(int i=0; i<8; i++)
		{
			ws2812SetColor(i, 0, 0, 255);
		}
		for(int i=8; i<21; i++)
		{
			ws2812SetColor(i, 255, 0, 0);
		}
		HAL_Delay(100);
	}
	offLed();
}

void blinkLed() {
	for(int n=0; n<3; n++)
	{
		for(int i=0; i<21; i++)
		{
			ws2812SetColor(i, 255, 255, 255);
		}
		HAL_Delay(100);
		offLed();
		HAL_Delay(100);
	}
}

/* USER CODE END 0 */

int main(void)
{

  /* MCU Configuration--------------------------------------------------------*/

  /* Reset of all peripherals, Initializes the Flash interface and the Systick. */
  HAL_Init();

  /* Configure the system clock */
  SystemClock_Config();

  /* Initialize all configured peripherals */
  MX_GPIO_Init();
  MX_DMA_Init();
  MX_TIM3_Init();
  /* USER CODE BEGIN 2 */

  ws2812Init();
  ws2812Begin(21);

  /* USER CODE END 2 */

  /* Infinite loop */
  while (1)
  {

    /* USER CODE BEGIN 3 */
	  blinkLed();
	  rgbLed();
	  sirenLed();
  }
  /* USER CODE END 3 */
}

void SystemClock_Config(void)
{
  RCC_OscInitTypeDef RCC_OscInitStruct = {0};
  RCC_ClkInitTypeDef RCC_ClkInitStruct = {0};

  /** Configure the main internal regulator output voltage
  */
  HAL_PWREx_ControlVoltageScaling(PWR_REGULATOR_VOLTAGE_SCALE1);

  /** Initializes the RCC Oscillators according to the specified parameters
  * in the RCC_OscInitTypeDef structure.
  */
  RCC_OscInitStruct.OscillatorType = RCC_OSCILLATORTYPE_HSI;
  RCC_OscInitStruct.HSIState = RCC_HSI_ON;
  RCC_OscInitStruct.HSIDiv = RCC_HSI_DIV128;
  RCC_OscInitStruct.HSICalibrationValue = RCC_HSICALIBRATION_DEFAULT;
  RCC_OscInitStruct.PLL.PLLState = RCC_PLL_ON;
  RCC_OscInitStruct.PLL.PLLSource = RCC_PLLSOURCE_HSI;
  RCC_OscInitStruct.PLL.PLLM = RCC_PLLM_DIV1;
  RCC_OscInitStruct.PLL.PLLN = 8;
  RCC_OscInitStruct.PLL.PLLP = RCC_PLLP_DIV2;
  RCC_OscInitStruct.PLL.PLLQ = RCC_PLLQ_DIV2;
  RCC_OscInitStruct.PLL.PLLR = RCC_PLLR_DIV2;
  if (HAL_RCC_OscConfig(&RCC_OscInitStruct) != HAL_OK)
  {
    Error_Handler();
  }

  /** Initializes the CPU, AHB and APB buses clocks
  */
  RCC_ClkInitStruct.ClockType = RCC_CLOCKTYPE_HCLK|RCC_CLOCKTYPE_SYSCLK
                              |RCC_CLOCKTYPE_PCLK1;
  RCC_ClkInitStruct.SYSCLKSource = RCC_SYSCLKSOURCE_PLLCLK;
  RCC_ClkInitStruct.AHBCLKDivider = RCC_SYSCLK_DIV1;
  RCC_ClkInitStruct.APB1CLKDivider = RCC_HCLK_DIV1;

  if (HAL_RCC_ClockConfig(&RCC_ClkInitStruct, FLASH_LATENCY_2) != HAL_OK)
  {
    Error_Handler();
  }
}

void Error_Handler(void)
{
  __disable_irq();
  while (1)
  {
  }
}
